## Yaohui_Yang/legacy/multi_anchor/epoch_firmware/anchor_A1/main/Kconfig.projbuild
```kconfig
menu "FTM + CSI 3-D anchor"
    config ANCHOR_ID
        int "Anchor ID (flash one unique ID to each board)"
        range 1 12
        default 1
    config ANCHOR_CHANNEL
        int "Common Wi-Fi channel"
        range 1 13
        default 6
    config ANCHOR_BW40
        bool "Use HT40 (all six boards must match)"
        default n
    config FTM_RESP_OFFSET_CM
        int "Responder hardware offset (cm)"
        range -30000 30000
        default 0
    config CSI_PROBE_PERIOD_MS
        int "CSI probe interval (ms)"
        range 25 1000
        default 40
endmenu
```

## Yaohui_Yang/legacy/multi_anchor/epoch_firmware/tag/main/Kconfig.projbuild
```kconfig
menu "FTM + CSI 3-D tag"
    config FTM_MAX_ANCHORS
        int "Maximum number of anchors"
        range 4 12
        default 7
    choice FTM_FRAME_COUNT_CHOICE
        prompt "FTM frames per session"
        default FTM_FRAMES_8
        config FTM_FRAMES_8
            bool "8"
        config FTM_FRAMES_16
            bool "16"
        config FTM_FRAMES_24
            bool "24"
        config FTM_FRAMES_32
            bool "32"
        config FTM_FRAMES_64
            bool "64"
    endchoice
    config FTM_FRAME_COUNT
        int
        default 8 if FTM_FRAMES_8
        default 16 if FTM_FRAMES_16
        default 24 if FTM_FRAMES_24
        default 32 if FTM_FRAMES_32
        default 64 if FTM_FRAMES_64
    config FTM_BURST_PERIOD
        int "Burst period in units of 100 ms (0 = no preference)"
        range 0 100
        default 0
    config FTM_SESSION_TIMEOUT_MS
        int "Per-anchor timeout (ms)"
        range 300 5000
        default 1500
    config FTM_RESCAN_PERIOD_MS
        int "Anchor rescan period (ms)"
        range 1000 60000
        default 10000
    config COMMON_CHANNEL
        int "Common CSI channel"
        range 1 13
        default 6
    config TAG_BW40
        bool "Use HT40 (must match anchors)"
        default n
    config TAG_FLASH_LOG
        bool "Store raw MFUSED lines on SPIFFS (off = stream to PC only)"
        default y
endmenu
```

## Yaohui_Yang/legacy/multi_anchor/five_anchor_3d/firmware/ftm_csi_3d/anchor/sdkconfig.defaults
```kconfig
CONFIG_IDF_TARGET_ESP32S3=y
CONFIG_ESP_WIFI_FTM_ENABLE=y
CONFIG_ESP_WIFI_FTM_RESPONDER_SUPPORT=y
CONFIG_ESP_WIFI_FTM_INITIATOR_SUPPORT=n
CONFIG_ESP_WIFI_CSI_ENABLED=n
CONFIG_FREERTOS_HZ=1000
```

## Yaohui_Yang/legacy/multi_anchor/five_anchor_3d/firmware/ftm_csi_3d/tag/main/Kconfig.projbuild
```kconfig
menu "FTM + CSI 3-D tag"
    config FTM_MAX_ANCHORS
        int "Number of anchors"
        range 4 5
        default 5
    choice FTM_FRAME_COUNT_CHOICE
        prompt "FTM frames per session"
        default FTM_FRAMES_16
        config FTM_FRAMES_16
            bool "16"
        config FTM_FRAMES_24
            bool "24"
        config FTM_FRAMES_32
            bool "32"
        config FTM_FRAMES_64
            bool "64"
    endchoice
    config FTM_FRAME_COUNT
        int
        default 16 if FTM_FRAMES_16
        default 24 if FTM_FRAMES_24
        default 32 if FTM_FRAMES_32
        default 64 if FTM_FRAMES_64
    config FTM_BURST_PERIOD
        int "Burst period in units of 100 ms (0 = no preference)"
        range 0 100
        default 0
    config FTM_SESSION_TIMEOUT_MS
        int "Per-anchor timeout (ms)"
        range 300 5000
        default 1500
    config FTM_RESCAN_PERIOD_MS
        int "Anchor rescan period (ms)"
        range 1000 60000
        default 10000
    config COMMON_CHANNEL
        int "Common CSI channel"
        range 1 13
        default 6
    config TAG_BW40
        bool "Use HT40 (must match anchors)"
        default n
endmenu
```

## Yaohui_Yang/legacy/multi_anchor/five_anchor_3d/firmware/ftm_only_baseline/responder/main/Kconfig.projbuild
```kconfig
menu "Multi-anchor responder"
    config FTM_ANCHOR_ID
        int "Anchor ID"
        range 1 8
        default 1
    config FTM_ANCHOR_CHANNEL
        int "Wi-Fi channel"
        range 1 13
        default 6
    config FTM_ANCHOR_BW40
        bool "Use HT40 bandwidth"
        default y
    config FTM_RESP_OFFSET_CM
        int "Responder hardware offset (cm)"
        range -30000 30000
        default 0
endmenu
```

## Yaohui_Yang/legacy/multi_anchor/five_anchor_3d/firmware/ftm_only_baseline/tag/main/Kconfig.projbuild
```kconfig
menu "Multi-anchor tag"
    config FTM_MAX_ANCHORS
        int "Maximum anchors"
        range 3 8
        default 4
    config FTM_FRAME_COUNT
        int "FTM frames per session (16/24/32/64)"
        range 16 64
        default 16
    config FTM_BURST_PERIOD
        int "Burst period in units of 100 ms (0 = no preference)"
        range 0 100
        default 0
    config FTM_SESSION_TIMEOUT_MS
        int "Per-anchor timeout (ms)"
        range 200 5000
        default 1200
    config FTM_RESCAN_PERIOD_MS
        int "Anchor rescan period (ms)"
        range 1000 60000
        default 10000
endmenu
```

## Yaohui_Yang/legacy/single_link/anchor_snapshot/sdkconfig.defaults
```kconfig
CONFIG_ESP_WIFI_FTM_ENABLE=y
CONFIG_ESP_WIFI_FTM_RESPONDER_SUPPORT=y
CONFIG_ESP_CONSOLE_UART_BAUDRATE=115200
```

## Yaohui_Yang/legacy/single_link/first_two_board_experiment/target/sdkconfig.defaults
```kconfig
CONFIG_ESP_WIFI_FTM_ENABLE=y
CONFIG_ESP_WIFI_FTM_INITIATOR_SUPPORT=y
CONFIG_ESP_WIFI_CSI_ENABLED=y
CONFIG_ESP_CONSOLE_UART_BAUDRATE=115200
```

## Yaohui_Yang/legacy/single_link/idf_6_0_2/tag/sdkconfig.defaults
```kconfig
CONFIG_IDF_TARGET="esp32s3"
CONFIG_ESP_WIFI_FTM_ENABLE=y
CONFIG_ESP_WIFI_CSI_ENABLED=y
CONFIG_ESP_CONSOLE_USB_SERIAL_JTAG=y
CONFIG_ESP_CONSOLE_UART_DEFAULT=n
```

## Yaohui_Yang/multi_anchor/gru_temporal/firmware/multi_anchor_3d/anchor/sdkconfig.defaults
```kconfig
CONFIG_IDF_TARGET_ESP32S3=y
CONFIG_ESP_WIFI_FTM_ENABLE=y
CONFIG_ESP_WIFI_FTM_RESPONDER_SUPPORT=y
CONFIG_ESP_WIFI_FTM_INITIATOR_SUPPORT=n
CONFIG_ESP_WIFI_CSI_ENABLED=n
CONFIG_FREERTOS_HZ=1000
CONFIG_ANCHOR_ID=1
CONFIG_ANCHOR_CHANNEL=6
CONFIG_CSI_PROBE_PERIOD_MS=40
```

## Yaohui_Yang/multi_anchor/gru_temporal/firmware/multi_anchor_3d/tag/sdkconfig.defaults
```kconfig
CONFIG_IDF_TARGET_ESP32S3=y
CONFIG_ESP_WIFI_FTM_ENABLE=y
CONFIG_ESP_WIFI_FTM_INITIATOR_SUPPORT=y
CONFIG_ESP_WIFI_FTM_RESPONDER_SUPPORT=n
CONFIG_ESP_WIFI_CSI_ENABLED=y
CONFIG_FREERTOS_HZ=1000
CONFIG_FTM_MAX_ANCHORS=12
CONFIG_FTM_FRAMES_8=y
CONFIG_FTM_BURST_PERIOD=20
CONFIG_COMMON_CHANNEL=6
CONFIG_PARTITION_TABLE_CUSTOM=y
CONFIG_PARTITION_TABLE_CUSTOM_FILENAME="partitions.csv"
```

## Yaohui_Yang/multi_anchor/six_anchor_2d/tag/sdkconfig.defaults
```kconfig
CONFIG_IDF_TARGET="esp32s3"
CONFIG_ESP_WIFI_FTM_ENABLE=y
CONFIG_ESP_WIFI_CSI_ENABLED=y
CONFIG_ESP_CONSOLE_UART_DEFAULT=y
# CONFIG_ESP_CONSOLE_USB_SERIAL_JTAG is not set
# CONFIG_ESP_CONSOLE_USB_CDC is not set
CONFIG_ESP_CONSOLE_SECONDARY_NONE=y
CONFIG_ESP_CONSOLE_UART_BAUDRATE=921600
```
